## meta-rcar-gen3/conf/machine/m3nulcb.conf
```bitbake
#@TYPE: Machine
#@NAME: M3NULCB machine
#@DESCRIPTION: Machine configuration for running M3NULCB

SOC_FAMILY = "r8a77965"

DEFAULTTUNE ?= "cortexa57"
require conf/machine/include/tune-cortexa57.inc
require conf/machine/include/rcar_ulcb.inc

# Device tree for M3NULCB
KERNEL_DEVICETREE = "renesas/r8a77965-ulcb.dtb"

# M3NULCB u-boot configure
UBOOT_MACHINE = "rcar3_ulcb_defconfig"
```

## meta-rcar-gen3/conf/machine/m3ulcb.conf
```bitbake
#@TYPE: Machine
#@NAME: M3ULCB machine
#@DESCRIPTION: Machine configuration for running M3ULCB

SOC_FAMILY = "r8a7796"

DEFAULTTUNE ?= "cortexa57-cortexa53"
require conf/machine/include/arm/armv8a/tune-cortexa57-cortexa53.inc
require conf/machine/include/rcar_ulcb.inc

# Device tree for M3ULCB
KERNEL_DEVICETREE = " \
    renesas/r8a77960-ulcb.dtb \
    renesas/r8a77961-ulcb.dtb \
"

# M3ULCB u-boot configure
UBOOT_CONFIG ??= "r8a7796_m3ulcb"
UBOOT_CONFIG[r8a7796_m3ulcb] = "rcar3_ulcb_defconfig"
```

## meta-rcar-gen3/conf/machine/salvator-x.conf
```bitbake
#@TYPE: Machine
#@NAME: Salvator-X machine
#@DESCRIPTION: Machine configuration for running Salvator-X

require conf/machine/include/rcar_common.inc
require include/safe-rendering-control.inc

# Add default tune for H3/M3
DEFAULTTUNE ?= "cortexa57-cortexa53"
# Add default tune for M3N
DEFAULTTUNE:r8a77965 = "cortexa57"

# Add tune configure file for M3N
TUNE_CONF ?= "conf/machine/include/arm/armv8a/tune-cortexa57-cortexa53.inc"
TUNE_CONF:r8a77965 = "conf/machine/include/tune-cortexa57.inc"

require ${TUNE_CONF}

# Device tree for H3
KERNEL_DEVICETREE:r8a7795 = " \
    renesas/r8a77950-salvator-x.dtb \
    renesas/r8a77951-salvator-x.dtb \
    renesas/r8a77951-salvator-xs.dtb \
    renesas/r8a779m1-salvator-xs.dtb \
    ${@oe.utils.conditional("USE_SAFE_RENDERING", "1", \
    "renesas/r8a77951-salvator-xs_cr7_rproc.dtb", "", d)} \
"

# Device tree for M3
KERNEL_DEVICETREE:r8a7796 = " \
    renesas/r8a77960-salvator-x.dtb \
    renesas/r8a77960-salvator-xs.dtb \
    renesas/r8a77961-salvator-xs.dtb \
    renesas/r8a779m3-salvator-xs.dtb \
    ${@oe.utils.conditional("USE_SAFE_RENDERING", "1", \
    "renesas/r8a77961-salvator-xs_cr7_rproc.dtb", "", d)} \
"

# Device tree for M3N
KERNEL_DEVICETREE:r8a77965 = " \
    renesas/r8a77965-salvator-x.dtb \
    renesas/r8a77965-salvator-xs.dtb \
    renesas/r8a779m5-salvator-xs.dtb \
    ${@oe.utils.conditional("USE_SAFE_RENDERING", "1", \
    "renesas/r8a77965-salvator-xs_cr7_rproc.dtb", "", d)} \
"

# H3 u-boot configure
UBOOT_CONFIG:r8a7795 ??= "r8a7795_salvator-x"
UBOOT_CONFIG[r8a7795_salvator-x] = "rcar3_salvator-x_defconfig"
# M3 u-boot configure
UBOOT_CONFIG:r8a7796 ??= "r8a7796_salvator-x"
UBOOT_CONFIG[r8a7796_salvator-x] = "rcar3_salvator-x_defconfig"
# M3N u-boot configure
UBOOT_CONFIG:r8a77965 ??= "r8a77965_salvator-x"
UBOOT_CONFIG[r8a77965_salvator-x] = "rcar3_salvator-x_defconfig"
```

## meta-rcar-gen5/conf/layer.conf
```bitbake
# We have a conf and classes directory, add to BBPATH
BBPATH .= ":${LAYERDIR}"

# We have recipes-* directories, add to BBFILES
BBFILES += "${LAYERDIR}/recipes-*/*/*.bb \
    ${LAYERDIR}/recipes-*/*/*.bbappend"

BBFILE_COLLECTIONS += "rcar-gen5"
BBFILE_PATTERN_rcar-gen5 = "^${LAYERDIR}/"
BBFILE_PRIORITY_rcar-gen5 = "6"
LAYERSERIES_COMPAT_rcar-gen5 = "dunfell"

LAYERDEPENDS_rcar-gen5 = "core yocto openembedded-layer meta-python"
```

## meta-rcar-gen5/conf/machine/include/rcar-gen5-common.inc
```bitbake
SOC_FAMILY =. "rcar-gen5:"
require conf/machine/include/soc-family.inc
LINUXLIBCVERSION = "5.10%"

MACHINE_FEATURES = ""

KERNEL_IMAGETYPE = "Image"
IMAGE_FSTYPES += "tar.bz2 cpio.gz ext4"

SERIAL_CONSOLES = "115200;ttySC0"

# Configuration for kernel
PREFERRED_PROVIDER_virtual/kernel = "linux-renesas"

# u-boot
EXTRA_IMAGEDEPENDS += " u-boot"

# Add variable to Build Configuration in build log
BUILDCFG_VARS_append = " SOC_FAMILY"

# Set Image & SDK name for Gen5
IMAGE_NAME = "${IMAGE_BASENAME}-x5h${IMAGE_VERSION_SUFFIX}"
IMAGE_LINK_NAME = "${IMAGE_BASENAME}-x5h"
SDK_NAME_x5h = "${DISTRO}-${TCLIBC}-${SDKMACHINE}-${IMAGE_BASENAME}-${TUNE_PKGARCH}-x5h"

# Configuration for Rcar GFX
DISTRO_FEATURES_remove = "${@bb.utils.contains('MACHINE_FEATURES', 'gsx', 'opengl', '', d)}"

PREFERRED_PROVIDER_virtual/egl = "${@bb.utils.contains('MACHINE_FEATURES', 'gsx', 'gles-user-module', '', d)}"
PREFERRED_PROVIDER_virtual/libgles2 = "${@bb.utils.contains('MACHINE_FEATURES', 'gsx', 'gles-user-module', '', d)}"
BBMASK += "${@bb.utils.contains('MACHINE_FEATURES', 'gsx', '', 'meta-renesas/meta-rcar-gen5/recipes-graphics/mesa/ \
                                meta-renesas/meta-rcar-gen5/recipes-kernel/kernel-module-gles/ \
                                meta-renesas/meta-rcar-gen5/recipes-graphics/gles-user-module/', d)}"
```

## meta-rcar-gen5/conf/machine/x5h.conf
```bitbake
#@TYPE: Machine
#@NAME: x5h machine
#@DESCRIPTION: Machine configuration for running X5H

SOC_FAMILY = "x5h"

DEFAULTTUNE ?= "aarch64"
require conf/machine/include/arm/arch-arm64.inc
require conf/machine/include/rcar-gen5-common.inc

# Device tree for X5H
KERNEL_DEVICETREE = " \
    renesas/r8a779g0-whitehawk.dtb \
    renesas/r8a779g0-whitehawk-native.dtb \
"

# X5H u-boot configure
UBOOT_CONFIG ??= "x5h"
UBOOT_CONFIG[x5h] = "rcar-x5h_board_defconfig"
```

## meta-rmobile/conf/layer.conf
```bitbake
# We have a conf and classes directory, append to BBPATH
BBPATH .= ":${LAYERDIR}"

# We have a recipes directory, add to BBFILES
BBFILES += "${LAYERDIR}/recipes*/*/*.bb \
	${LAYERDIR}/recipes*/*/*.bbappend"

BBFILE_COLLECTIONS += "rmobile"
BBFILE_PATTERN_rmobile := "^${LAYERDIR}/"
BBFILE_PRIORITY_rmobile = "6"
```

## meta-rmobile/conf/machine/armadillo800eva.conf
```bitbake
#@TYPE: Machine
#@NAME: armadillo 800eva
#@DESCRIPTION: Machine configuration for the armadillo 800 eva
include conf/machine/include/tune-cortexa9.inc

DEFAULTTUNE = "cortexa9hf-neon"

UBOOT_MACHINE = "armadillo-800eva_config"

KERNEL_DEVICETREE = "${S}/arch/arm/boot/dts/r8a7740-armadillo800eva.dts"

IMAGE_FSTYPES += "tar.bz2"

SERIAL_CONSOLE = "115200 ttySC1"
```
