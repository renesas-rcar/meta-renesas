## conf/layer.conf
```bitbake
# We have a conf and classes directory, append to BBPATH
BBPATH .= ":${LAYERDIR}"

# We have a recipes directory, add to BBFILES
BBFILES += "${LAYERDIR}/common/recipes-*/*/*.bb \
	${LAYERDIR}/common/recipes-*/*/*.bbappend"

BBFILE_COLLECTIONS += "renesas"
BBFILE_PATTERN_renesas := "^${LAYERDIR}/"
BBFILE_PRIORITY_renesas = "5"
```

## conf/machine/bockw.conf
```bitbake
#@TYPE: Machine
#@NAME: bockw
#@DESCRIPTION: Machine configuration for the bockw board
require conf/machine/include/r8a7778.inc

KERNEL_IMAGETYPE = "zImage"

PREFERRED_PROVIDER_virtual/kernel ?= "linux-yocto"
PREFERRED_VERSION_linux-yocto ?= "3.4%"

IMAGE_FSTYPES += "tar.bz2"

SERIAL_CONSOLE = "115200 ttySC0"

MACHINE_EXTRA_RRECOMMENDS = "kernel-modules"
MACHINE_FEATURES = "serial mmc alsa ext2 touchscreen usbhost vfat ethernet"
```

## conf/machine/include/r8a7740.inc
```bitbake
include conf/machine/include/renesas-default-providers.inc

include conf/machine/include/soc-family.inc
include conf/machine/include/tune-cortexa9.inc

SOC_FAMILY = "r8a7740"
```

## conf/machine/include/renesas-default-providers.inc
```bitbake
# Renesas BSP default providers

IMAGE_DEVICE_TABLES = "files/device_table-minimal.txt \
		files/device_table_add-renesas.txt"
```

## conf/machine/include/sh73a0.inc
```bitbake
include conf/machine/include/renesas-default-providers.inc

include conf/machine/include/soc-family.inc
include conf/machine/include/tune-cortexa9.inc

SOC_FAMILY = "sh73a0"
```

## conf/machine/include/tune-cortexa7.inc
```bitbake
DEFAULTTUNE ?= "cortexa7-neon"

require conf/machine/include/arm/arch-armv7a.inc

TUNEVALID[cortexa7] = "Enable Cortex-A7 specific processor optimizations"
TUNE_CCARGS += "${@bb.utils.contains("TUNE_FEATURES", "cortexa7", "-mtune=cortex-a7", "", d)}"

# Little Endian base configs
AVAILTUNES += "cortexa7 cortexa7t cortexa7-neon"
TUNE_FEATURES_tune-cortexa7 = "${TUNE_FEATURES_tune-armv7a} cortexa7"
TUNE_FEATURES_tune-cortexa7t = "${TUNE_FEATURES_tune-armv7at} cortexa7"
TUNE_FEATURES_tune-cortexa7-neon = "${TUNE_FEATURES_tune-armv7a-neon} cortexa7"
PACKAGE_EXTRA_ARCHS_tune-cortexa7 = "${PACKAGE_EXTRA_ARCHS_tune-armv7a}"
PACKAGE_EXTRA_ARCHS_tune-cortexa7t = "${PACKAGE_EXTRA_ARCHS_tune-armv7at}"
PACKAGE_EXTRA_ARCHS_tune-cortexa7-neon = "${PACKAGE_EXTRA_ARCHS_tune-armv7a-neon}"

# VFP Tunes
AVAILTUNES += "cortexa7hf cortexa7thf cortexa7hf-neon"
TUNE_FEATURES_tune-cortexa7hf ?= "${TUNE_FEATURES_tune-armv7ahf} cortexa7"
TUNE_FEATURES_tune-cortexa7thf ?= "${TUNE_FEATURES_tune-armv7athf} cortexa7"
TUNE_FEATURES_tune-cortexa7hf-neon ?= "${TUNE_FEATURES_tune-armv7ahf-neon} cortexa7"
PACKAGE_EXTRA_ARCHS_tune-cortexa7hf = "${PACKAGE_EXTRA_ARCHS_tune-armv7ahf}"
PACKAGE_EXTRA_ARCHS_tune-cortexa7thf = "${PACKAGE_EXTRA_ARCHS_tune-armv7athf}"
PACKAGE_EXTRA_ARCHS_tune-cortexa7hf-neon = "${PACKAGE_EXTRA_ARCHS_tune-armv7ahf-neon}"
```

## conf/machine/koelsch.conf
```bitbake
#@TYPE: Machine
#@NAME: koelsch

#@DESCRIPTION: Machine configuration for koelsch systems


# Ship all kernel modules by default
MACHINE_EXTRA_RRECOMMENDS = " kernel-modules"

# Allow for MMC booting (required by the NAND-less Beagleboard XM)
EXTRA_IMAGEDEPENDS += "u-boot"

# Uncomment the following line to enable the hard floating point abi. Note that
# this breaks some binary libraries and 3D (neither of which ship with
# meta-yocto). For maximum compatibility, leave this disabled.
#DEFAULTTUNE ?= "cortexa8hf-neon"
DEFAULTTUNE ?= "cortexa15hf-neon"
include conf/machine/include/tune-cortexa15.inc

IMAGE_FSTYPES += "tar.bz2 jffs2"
EXTRA_IMAGECMD_jffs2 = "-lnp "

SERIAL_CONSOLE = "38400 ttySC6"

PREFERRED_PROVIDER_virtual/kernel ?= "linux-yocto"
PREFERRED_VERSION_linux-yocto ?= "3.4%"

KERNEL_IMAGETYPE = "uImage"
KERNEL_DEVICETREE = "${S}/arch/arm/boot/dts/r8a7791-koelsch.dts"

EXTRA_IMAGEDEPENDS += "u-boot"
PREFERRED_PROVIDER_u-boot ?= "u-boot"
PREFERRED_VERSION_u-boot ?= "v2013.07%"
UBOOT_MACHINE = "koelsch_config"
UBOOT_ENTRYPOINT = "0x40008000"
UBOOT_LOADADDRESS = "0x40007fc0"

MACHINE_FEATURES = "apm usbgadget usbhost vfat alsa"
```

## conf/machine/kzm9g.conf
```bitbake
#@TYPE: Machine
#@NAME: KMC kzm9g
#@DESCRIPTION: Machine configuration for the kzm9g
require conf/machine/include/sh73a0.inc

UBOOT_MACHINE = "kzm9g_config"

KERNEL_IMAGETYPE = "zImage"
KERNEL_DEVICETREE = "${S}/arch/arm/boot/dts/sh73a0-kzm9g.dts"

IMAGE_FSTYPES += "tar.bz2"

SERIAL_CONSOLE = "115200 ttySC1"

MACHINE_EXTRA_RRECOMMENDS = "kernel-modules"
MACHINE_FEATURES = "kernel26 serial mmc alsa ext2 touchscreen usbhost vfat ethernet"
```

## conf/machine/lager.conf
```bitbake
#@TYPE: Machine
#@NAME: lager
#@DESCRIPTION: Machine configuration for the lager board
DEFAULTTUNE ?= "cortexa15hf-neon"
include conf/machine/include/tune-cortexa15.inc

EXTRA_IMAGEDEPENDS += "u-boot"
PREFERRED_PROVIDER_u-boot ?= "u-boot"
PREFERRED_VERSION_u-boot ?= "v2013.01%"
UBOOT_MACHINE = "lager_config"
UBOOT_ENTRYPOINT = "0x40008000"
UBOOT_LOADADDRESS = "0x40007fc0"

PREFERRED_PROVIDER_virtual/kernel ?= "linux-yocto"
PREFERRED_VERSION_linux-yocto ?= "3.4%"
PREFERRED_PROVIDER_linux-libc-headers ?= "linux-libc-headers"
#PREFERRED_VERSION_linux-libc-headers ?= "3.4%"

IMAGE_FSTYPES += "tar.bz2"

SERIAL_CONSOLE = "38400 ttySC6"

KERNEL_IMAGETYPE = "uImage"
KERNEL_DEVICETREE = "${S}/arch/arm/boot/dts/r8a7790-lager.dts"

MACHINE_EXTRA_RRECOMMENDS = "kernel-modules"
MACHINE_FEATURES = "serial mmc alsa ext2 touchscreen usbhost vfat ethernet"
```

## meta-alt/conf/layer.conf
```bitbake
# We have a conf and classes directory, add to BBPATH
BBPATH .= ":${LAYERDIR}"

# We have a recipes-* directories, add to BBFILES
BBFILES += "${LAYERDIR}/recipes-*/*/*.bb \
	${LAYERDIR}/recipes-*/*/*.bbappend"

BBFILE_COLLECTIONS += "alt"
BBFILE_PATTERN_alt = "^${LAYERDIR}/"
BBFILE_PRIORITY_alt = "6"
```

## meta-armadillo800eva/conf/layer.conf
```bitbake
# We have a conf and classes directory, append to BBPATH
BBPATH .= ":${LAYERDIR}"

# We have a recipes directory, add to BBFILES
BBFILES += "${LAYERDIR}/recipes*/*/*.bb \
	${LAYERDIR}/recipes*/*/*.bbappend"

BBFILE_COLLECTIONS += "armadillo800eva"
BBFILE_PATTERN_armadillo800eva := "^${LAYERDIR}/"
BBFILE_PRIORITY_armadillo800eva = "6"
```

## meta-armadillo800eva/conf/machine/armadillo800eva.conf
```bitbake
#@TYPE: Machine
#@NAME: armadillo 800eva
#@DESCRIPTION: Machine configuration for the armadillo 800 eva
include conf/machine/include/tune-cortexa9.inc

DEFAULTTUNE = "cortexa9hf-neon"

EXTRA_IMAGEDEPENDS += "u-boot"
PREFERRED_PROVIDER_u-boot ?= "u-boot"
PREFERRED_VERSION_u-boot ?= "v2013.01.01"
UBOOT_MACHINE = "armadillo-800eva_config"

KERNEL_IMAGETYPE = "zImage"
KERNEL_DEVICETREE = "${S}/arch/arm/boot/dts/r8a7740-armadillo800eva.dts"

PREFERRED_PROVIDER_virtual/kernel ?= "linux-yocto"
PREFERRED_VERSION_linux-yocto ?= "3.4%"

IMAGE_FSTYPES += "tar.bz2"

SERIAL_CONSOLE = "115200 ttySC1"

MACHINE_EXTRA_RRECOMMENDS = "kernel-modules"
MACHINE_FEATURES = "serial mmc alsa ext2 touchscreen usbhost vfat ethernet"
```

## meta-bockw/conf/layer.conf
```bitbake
# We have a conf and classes directory, append to BBPATH
BBPATH .= ":${LAYERDIR}"

# We have a recipes directory, add to BBFILES
BBFILES += "${LAYERDIR}/recipes-*/*/*.bb \
	${LAYERDIR}/recipes-*/*/*.bbappend"

BBFILE_COLLECTIONS += "bockw"
BBFILE_PATTERN_bockw := "^${LAYERDIR}/"
BBFILE_PRIORITY_bockw = "6"

LAYERDEPENDS_bockw = "renesas" 
```

## meta-bockw/conf/machine/bockw.conf
```bitbake
#@TYPE: Machine
#@NAME: bockw
#@DESCRIPTION: Machine configuration for the bockw board
include conf/machine/include/tune-cortexa9.inc

KERNEL_IMAGETYPE = "uImage"
KERNEL_DEVICETREE = "${S}/arch/arm/boot/dts/r8a7778-bockw.dts"

PREFERRED_PROVIDER_virtual/kernel ?= "linux-yocto"
PREFERRED_VERSION_linux-yocto ?= "3.4%"
PREFERRED_PROVIDER_linux-libc-headers ?= "linux-libc-headers"
PREFERRED_VERSION_linux-libc-headers ?= "3.4%"

IMAGE_FSTYPES += "tar.bz2"

SERIAL_CONSOLE = "115200 ttySC0"

MACHINE_EXTRA_RRECOMMENDS = "kernel-modules"
MACHINE_FEATURES = "serial mmc alsa ext2 touchscreen usbhost vfat ethernet"
```

## meta-koelsch/conf/layer.conf
```bitbake
# We have a conf and classes directory, add to BBPATH
BBPATH .= ":${LAYERDIR}"

# We have a recipes-* directories, add to BBFILES
BBFILES += "${LAYERDIR}/recipes-*/*/*.bb \
	${LAYERDIR}/recipes-*/*/*.bbappend"

BBFILE_COLLECTIONS += "koelsch"
BBFILE_PATTERN_koelsch = "^${LAYERDIR}/"
BBFILE_PRIORITY_koelsch = "6"
```

## meta-koelsch/conf/machine/koelsch.conf
```bitbake
#@TYPE: Machine
#@NAME: koelsch

#@DESCRIPTION: Machine configuration for koelsch systems

# Ship all kernel modules by default
MACHINE_EXTRA_RRECOMMENDS = " kernel-modules"

# Allow for MMC booting (required by the NAND-less Beagleboard XM)
EXTRA_IMAGEDEPENDS += "u-boot"

# Uncomment the following line to enable the hard floating point abi. Note that
# this breaks some binary libraries and 3D (neither of which ship with
# meta-yocto). For maximum compatibility, leave this disabled.
DEFAULTTUNE ?= "cortexa15hf-neon"
include conf/machine/include/tune-cortexa15.inc

IMAGE_FSTYPES += "tar.bz2 jffs2"
EXTRA_IMAGECMD_jffs2 = "-lnp "

SERIAL_CONSOLE = "38400 ttySC6"

PREFERRED_PROVIDER_virtual/kernel ?= "linux-yocto"
PREFERRED_VERSION_linux-yocto ?= "3.10%"

KERNEL_IMAGETYPE = "uImage"
KERNEL_DEVICETREE = "${S}/arch/arm/boot/dts/r8a7791-koelsch.dts"
KERNEL_EXTRA_ARGS += "LOADADDR=${UBOOT_ENTRYPOINT}" 

EXTRA_IMAGEDEPENDS += "u-boot"
PREFERRED_PROVIDER_u-boot ?= "u-boot"
PREFERRED_VERSION_u-boot ?= "v2013.01%"
UBOOT_MACHINE = "koelsch_config"
UBOOT_ENTRYPOINT = "0x40008000"
UBOOT_LOADADDRESS = "0x40007fc0"

MACHINE_FEATURES = "apm usbgadget usbhost vfat alsa"

# koelsch depends version 2.4.45 of libdrm
PREFERRED_VERSION_libdrm = "2.4.45%"
```

## meta-lager/conf/layer.conf
```bitbake
# We have a conf and classes directory, append to BBPATH
BBPATH .= ":${LAYERDIR}"

# We have a recipes directory, add to BBFILES
BBFILES += "${LAYERDIR}/recipes*/*/*.bb \
	${LAYERDIR}/recipes*/*/*.bbappend"

BBFILE_COLLECTIONS += "lager"
BBFILE_PATTERN_lager := "^${LAYERDIR}/"
BBFILE_PRIORITY_lager = "6"
```

## meta-lager/conf/machine/lager.conf
```bitbake
#@TYPE: Machine
#@NAME: lager
#@DESCRIPTION: Machine configuration for the lager board
DEFAULTTUNE ?= "cortexa15hf-neon"
include conf/machine/include/tune-cortexa15.inc

EXTRA_IMAGEDEPENDS += "u-boot"
PREFERRED_PROVIDER_u-boot ?= "u-boot"
PREFERRED_VERSION_u-boot ?= "v2013.01%"
UBOOT_MACHINE = "lager_config"
UBOOT_ENTRYPOINT = "0x40008000"
UBOOT_LOADADDRESS = "0x40007fc0"

PREFERRED_PROVIDER_virtual/kernel ?= "linux-yocto"
PREFERRED_VERSION_linux-yocto ?= "3.10%"
PREFERRED_PROVIDER_linux-libc-headers ?= "linux-libc-headers"
#PREFERRED_VERSION_linux-libc-headers ?= "3.4%"
PREFERRED_VERSION_gcc-cross = "linaro-4.8"
PREFERRED_VERSION_gcc-cross-initial = "linaro-4.8"
PREFERRED_VERSION_gcc-cross-intermediate = "linaro-4.8"
PREFERRED_VERSION_gcc-crosssdk = "linaro-4.8"
PREFERRED_VERSION_gcc-crosssdk-initial = "linaro-4.8"
PREFERRED_VERSION_gcc-crosssdk-intermediate = "linaro-4.8"
PREFERRED_VERSION_gcc-cross-canadian-${TRANSLATED_TARGET_ARCH} = "linaro-4.8"

IMAGE_FSTYPES += "tar.bz2"

SERIAL_CONSOLE = "38400 ttySC6"

KERNEL_IMAGETYPE = "uImage"
KERNEL_DEVICETREE = "${S}/arch/arm/boot/dts/r8a7790-lager.dts"
KERNEL_EXTRA_ARGS += "LOADADDR=${UBOOT_ENTRYPOINT}"

MACHINE_EXTRA_RRECOMMENDS = "kernel-modules"
MACHINE_FEATURES = "serial mmc alsa ext2 touchscreen usbhost vfat ethernet"

# koelsch depends version 2.4.45 of libdrm
PREFERRED_VERSION_libdrm = "2.4.45%"
```

## meta-marzen/conf/layer.conf
```bitbake
# We have a conf and classes directory, add to BBPATH
BBPATH := "${BBPATH}:${LAYERDIR}"

# We have a recipes directory, add to BBFILES
BBFILES := "${BBFILES} ${LAYERDIR}/recipes-*/*/*.bb \
	${LAYERDIR}/recipes-*/*/*.bbappend"

BBFILE_COLLECTIONS += "marzen"
BBFILE_PATTERN_marzen := "^${LAYERDIR}/"
BBFILE_PRIORITY_marzen = "6"

LAYERDEPENDS_bockw = "renesas"
```

## meta-marzen/conf/machine/marzen.conf
```bitbake
#@TYPE: Machine
#@NAME: marzen

#@DESCRIPTION: Machine configuration for Renesas R-Car H1 Marzen systems


# Ship all kernel modules by default
MACHINE_EXTRA_RRECOMMENDS = " kernel-modules"

EXTRA_IMAGEDEPENDS += "u-boot"

include conf/machine/include/tune-cortexa9.inc

IMAGE_FSTYPES += "tar.bz2 jffs2"
EXTRA_IMAGECMD_jffs2 = "-lnp "

SERIAL_CONSOLE = "115200 ttySC2"

# Yocto kernel recipe
# PREFERRED_PROVIDER_virtual/kernel ?= "linux-yocto"
# PREFERRED_VERSION_linux-yocto ?= "3.4%"

# Mainline kernel recipe
PREFERRED_PROVIDER_virtual/kernel ?= "linux-yocto"
PREFERRED_VERSION_linux-mainline ?= "3.4%"

#PREFERRED_PROVIDER_u-boot ?= "u-boot"
PREFERRED_VERSION_u-boot ?= "v2011.03%"

KERNEL_IMAGETYPE = "uImage"

UBOOT_MACHINE = "marzen_config"
UBOOT_ENTRYPOINT = "0x60008000"
UBOOT_LOADADDRESS = "0x60008000"

MACHINE_FEATURES = "apm usbgadget usbhost vfat alsa"
```
