## meta-rcar-gen2/conf/machine/include/rcar-gen2-providers.inc
```bitbake
# Configure for using linaro toolchain
PREFERRED_VERSION_gcc-cross = "linaro-4.8"
PREFERRED_VERSION_gcc-cross-initial = "linaro-4.8"
PREFERRED_VERSION_gcc-cross-intermediate = "linaro-4.8"
PREFERRED_VERSION_gcc-crosssdk = "linaro-4.8"
PREFERRED_VERSION_gcc-crosssdk-initial = "linaro-4.8"
PREFERRED_VERSION_gcc-crosssdk-intermediate = "linaro-4.8"
PREFERRED_VERSION_gcc-cross-canadian-${TRANSLATED_TARGET_ARCH} = "linaro-4.8"
```

## meta-rcar-gen2/conf/machine/include/wayland-gfx.inc
```bitbake
MULTI_PROVIDER_WHITELIST += "virtual/libgl virtual/egl virtual/libgles1 virtual/libgles2"
PREFERRED_PROVIDER_virtual/libgles1 = ""
PREFERRED_PROVIDER_virtual/libgles2 = "gles-user-module"
PREFERRED_PROVIDER_virtual/egl = "libegl"
PREFERRED_PROVIDER_virtual/libgl = ""
PREFERRED_PROVIDER_virtual/mesa = ""
PREFERRED_PROVIDER_libgbm = "libgbm"
PREFERRED_PROVIDER_libgbm-dev = "libgbm"
```

## meta-rcar-gen2/conf/machine/include/wayland-nogfx.inc
```bitbake
WAYLAND_GFX_ENABLE ?= "0"

BBMASK .= "|libegl|libgbm|wayland-kms|wayland-wsegl"
BBMASK .= "|meta-renesas/meta-rcar-gen2/recipes-graphics/mesa"
BBMASK .= "|meta-renesas/meta-rcar-gen2/recipes-graphics/cogl"
```

## meta-rcar-gen2/conf/machine/include/wayland.inc
```bitbake
DISTRO_FEATURES_append = " wayland pam"

GLES_ENABLE ?= "0"
#Wayland uses GFX when it is enable
WAYLAND_GFX_ENABLE='${@"1" if ${GLES_ENABLE} == 1 else "0"}'
GLES_TP_ENABLE = "0"

include ${@'wayland-gfx.inc' if ${WAYLAND_GFX_ENABLE}==1 else 'wayland-nogfx.inc'}

# Fix version opengles2 for Wayland environment
OPENGLES3 = "0"

DISTRO_FEATURES_remove="x11"
```

## meta-rcar-gen2/conf/machine/include/x11.inc
```bitbake
MULTI_PROVIDER_WHITELIST += "virtual/libgl virtual/egl virtual/libgles1 virtual/libgles2"
PREFERRED_PROVIDER_virtual/libgles2 = " \
        ${@base_contains('MACHINE_FEATURES', 'rgx', 'gles-user-module', \
        base_contains('MACHINE_FEATURES', 'sgx', 'gles-user-module', \
        '', d), d)}"
PREFERRED_PROVIDER_virtual/egl =" \
        ${@base_contains('MACHINE_FEATURES', 'rgx', 'gles-user-module', \
        base_contains('MACHINE_FEATURES', 'sgx', 'gles-user-module', \
        '', d), d)}"
PREFERRED_PROVIDER_virtual/libgl = "mesa-gl"
PREFERRED_PROVIDER_virtual/mesa = "mesa-gl"
DISTRO_FEATURES_remove = "wayland"

WAYLAND_GFX_ENABLE ?= "0"

BBMASK .= "|libegl|libgbm|wayland-kms|wayland-wsegl"
BBMASK .= "|meta-renesas/meta-rcar-gen2/recipes-graphics/cogl"
```

## meta-rcar-gen2/conf/machine/koelsch.conf
```bitbake
#@TYPE: Machine
#@NAME: koelsch
#@DESCRIPTION: Machine configuration for koelsch systems

require conf/machine/include/r8a7791.inc
require conf/machine/include/rcar-gen2-providers.inc

MACHINE_EXTRA_RRECOMMENDS = " kernel-modules"
DEFAULTTUNE = "cortexa15hf-neon"

IMAGE_FSTYPES += "tar.bz2"

SERIAL_CONSOLE = "38400 ttySC6"

KERNEL_DEVICETREE = "${S}/arch/arm/boot/dts/r8a7791-koelsch.dts"

UBOOT_MACHINE = "koelsch_config"

# koelsch depends version 2.4.45 of libdrm
PREFERRED_VERSION_libdrm = "2.4.45%"
```

## meta-rcar-gen2/conf/machine/lager.conf
```bitbake
#@TYPE: Machine
#@NAME: lager
#@DESCRIPTION: Machine configuration for lager systems

require conf/machine/include/r8a7790.inc
require conf/machine/include/rcar-gen2-providers.inc

MACHINE_EXTRA_RRECOMMENDS = " kernel-modules"
DEFAULTTUNE = "cortexa15hf-neon"

IMAGE_FSTYPES += "tar.bz2"

SERIAL_CONSOLE = "38400 ttySC6"

KERNEL_DEVICETREE = "${S}/arch/arm/boot/dts/r8a7790-lager.dts"

UBOOT_MACHINE = "lager_config"

# lager depends version 2.4.45 of libdrm
PREFERRED_VERSION_libdrm = "2.4.45%"
```

## meta-rcar-gen2/conf/machine/porter.conf
```bitbake
#@TYPE: Machine
#@NAME: porter
#@DESCRIPTION: Machine configuration for porter systems

require conf/machine/include/r8a7791.inc
require conf/machine/include/rcar-gen2-providers.inc

MACHINE_EXTRA_RRECOMMENDS = " kernel-modules"

IMAGE_FSTYPES += "tar.bz2"

SERIAL_CONSOLE = "38400 ttySC6"

KERNEL_DEVICETREE = "${S}/arch/arm/boot/dts/r8a7791-porter.dts"

KERNEL_EXTRA_ARGS += "LOADADDR=${UBOOT_ENTRYPOINT}"

UBOOT_MACHINE = "porter_config"
UBOOT_ENTRYPOINT = "0x40008000"
UBOOT_LOADADDRESS = "0x40007fc0"

PREFERRED_VERSION_linux-renesas = "3.10%"
PREFERRED_VERSION_linux-libc-headers = "3.10%"
PREFERRED_VERSION_nativesdk-linux-libc-headers = "3.10%"
PREFERRED_VERSION_u-boot = "v2013.01%"
PREFERRED_VERSION_libdrm = "2.4.45%"

MACHINE_FEATURES = "apm usbgadget usbhost vfat alsa ethernet"
```

## meta-rcar-gen2/conf/machine/silk.conf
```bitbake
#@TYPE: Machine
#@NAME: silk
#@DESCRIPTION: Machine configuration for silk systems

require conf/machine/include/r8a7794.inc
require conf/machine/include/rcar-gen2-providers.inc

MACHINE_EXTRA_RRECOMMENDS = " kernel-modules"

IMAGE_FSTYPES += "tar.bz2"

SERIAL_CONSOLE = "38400 ttySC10"

KERNEL_DEVICETREE = "${S}/arch/arm/boot/dts/r8a7794-silk.dts"

KERNEL_EXTRA_ARGS += "LOADADDR=${UBOOT_ENTRYPOINT}"

UBOOT_MACHINE = "silk_config"
UBOOT_ENTRYPOINT = "0x40008000"
UBOOT_LOADADDRESS = "0x40007fc0"

PREFERRED_VERSION_linux-renesas = "3.10%"
PREFERRED_VERSION_linux-libc-headers = "3.10%"
PREFERRED_VERSION_nativesdk-linux-libc-headers = "3.10%"
PREFERRED_VERSION_u-boot = "v2013.01%"
PREFERRED_VERSION_libdrm = "2.4.45%"

MACHINE_FEATURES = "apm usbgadget usbhost vfat alsa ethernet"
```

## meta-rcar-gen2/conf/machine/wheat.conf
```bitbake
#@TYPE: Machine
#@NAME: Blanche machine
#@DESCRIPTION: Machine configuration for running Wheat

SOC_FAMILY = "rcar-gen2:r8a7792"
require conf/machine/include/soc-family.inc
DEFAULTTUNE ?= "cortexa15hf-neon"
require conf/machine/include/tune-cortexa15.inc

LINUXLIBCVERSION = "4.6"

KERNEL_IMAGETYPE = "uImage"
IMAGE_FSTYPES = "tar.bz2 ext4 cpio.gz"

SERIAL_CONSOLE = "115200 ttySC0"

# Configuration for kernel
PREFERRED_PROVIDER_virtual/kernel = "linux-renesas"
PREFERRED_PROVIDER_linux-libc-headers = "linux-libc-headers"
PREFERRED_PROVIDER_nativesdk-linux-libc-headers = "nativesdk-linux-libc-headers"
PREFERRED_PROVIDER_u-boot = "u-boot"

# Device tree for Wheat
KERNEL_DEVICETREE = "${S}/arch/arm/boot/dts/r8a7792-wheat.dts"

# u-boot
PREFERRED_VERSION_u-boot = "rmobile%"
EXTRA_IMAGEDEPENDS += " u-boot"

KERNEL_EXTRA_ARGS += "LOADADDR=${UBOOT_ENTRYPOINT}"

UBOOT_MACHINE ?= "wheat_config"
UBOOT_ENTRYPOINT = "0x40008000"
UBOOT_LOADADDRESS = "0x40007fc0"

# libdrm
PREFERRED_VERSION_libdrm = "2.4.68"

# Add variable to Build Configuration in build log
BUILDCFG_VARS_append = " SOC_FAMILY"

MACHINE_EXTRA_RRECOMMENDS = " kernel-modules kernel-devicetree"

MACHINE_FEATURES = "apm vfat alsa ethernet"
```

## meta-rcar-gen3/conf/layer.conf
```bitbake
# We have a conf and classes directory, add to BBPATH
BBPATH .= ":${LAYERDIR}"

# We have recipes-* directories, add to BBFILES
BBFILES += "${LAYERDIR}/recipes-*/*/*.bb \
    ${LAYERDIR}/recipes-*/*/*.bbappend"

BBFILE_COLLECTIONS += "rcar-gen3"
BBFILE_PATTERN_rcar-gen3 = "^${LAYERDIR}/"
BBFILE_PRIORITY_rcar-gen3 = "6"
LAYERSERIES_COMPAT_rcar-gen3 = "dunfell"

LAYERDEPENDS_rcar-gen3 = "core yocto yoctobsp openembedded-layer meta-python"
# Disable srecord .bbappend file if machine not in rcar-gen3 to fix YP compatible
# The content in srecord_%.bbappend is for srecord-native, so cannot use overides
BBMASK += "${@bb.utils.contains('MACHINEOVERRIDES', 'rcar-gen3', '', 'meta-renesas/meta-rcar-gen3/recipes-support/srecord/', d)}"
```

## meta-rcar-gen3/conf/machine/draak.conf
```bitbake
#@TYPE: Machine
#@NAME: Draak machine
#@DESCRIPTION: Machine configuration for running Draak

SOC_FAMILY = "r8a77995"
DEFAULTTUNE ?= "cortexa53"

require conf/machine/include/arm/armv8a/tune-cortexa53.inc
require conf/machine/include/rcar_common.inc

# Configuration for kernel
PREFERRED_PROVIDER_virtual/kernel = "linux-renesas"
# Device tree for D3
KERNEL_DEVICETREE = "renesas/r8a77995-draak.dtb"

# D3 u-boot configure
UBOOT_MACHINE = "r8a77995_draak_defconfig"
```

## meta-rcar-gen3/conf/machine/ebisu.conf
```bitbake
#@TYPE: Machine
#@NAME: Ebisu machine
#@DESCRIPTION: Machine configuration for running Ebisu

SOC_FAMILY = "r8a77990"

DEFAULTTUNE ?= "cortexa53"
require conf/machine/include/tune-cortexa53.inc
require conf/machine/include/rcar_common.inc

# Device tree for E3
KERNEL_DEVICETREE = " \
    renesas/r8a77990-ebisu.dtb \
    renesas/r8a77990-ebisu-4d.dtb \
    renesas/r8a77990-es10-ebisu.dtb \
    renesas/r8a77990-es10-ebisu-4d.dtb \
    ${@oe.utils.conditional("USE_SAFE_RENDERING", "1", \
    "renesas/r8a77990-ebisu-4d_cr7_rproc.dtb \
    renesas/r8a77990-es10-ebisu-4d_cr7_rproc.dtb", "", d)} \
"

# E3 u-boot configure
UBOOT_CONFIG ??= "ebisu"
UBOOT_CONFIG[ebisu] = "r8a77990_ebisu_defconfig"
```

## meta-rcar-gen3/conf/machine/h3ulcb.conf
```bitbake
#@TYPE: Machine
#@NAME: H3ULCB machine
#@DESCRIPTION: Machine configuration for running H3ULCB

SOC_FAMILY = "r8a7795"

DEFAULTTUNE ?= "cortexa57-cortexa53"
require conf/machine/include/arm/armv8a/tune-cortexa57-cortexa53.inc
require conf/machine/include/rcar_ulcb.inc

# Device tree for H3ULCB
KERNEL_DEVICETREE = " \
    renesas/r8a77951-ulcb.dtb \
    renesas/r8a779m1-ulcb.dtb \
"

# H3ULCB u-boot configure
UBOOT_CONFIG ??= "r8a7795_h3ulcb"
UBOOT_CONFIG[r8a7795_h3ulcb] = "rcar3_ulcb_defconfig"
```

## meta-rcar-gen3/conf/machine/include/multilib.inc
```bitbake
# Configuration for Multilib
require conf/multilib.conf
MULTILIBS = "multilib:lib32"
DEFAULTTUNE_virtclass-multilib-lib32 = "armv7ahf-neon"

# Configuration for SDK
SDKTARGETSYSROOT_virtclass-multilib-lib32 = \
    "${SDKPATH}/sysroots/aarch64-pokymllib32-linux"

# Add the preferred version for gdb-cross canadian
# and binutils-cross canadian.
PREFERRED_VERSION_binutils-cross-canadian-arm = "${BINUVERSION}"
PREFERRED_VERSION_gdb-cross-canadian-arm = "${GDBVERSION}"
```

## meta-rcar-gen3/conf/machine/include/r8a7795.inc
```bitbake
SOC_FAMILY = "rcar-gen3:r8a7795"
require conf/machine/include/soc-family.inc
LINUXLIBCVERSION = "4.2"
```

## meta-rcar-gen3/conf/machine/include/r8a77965.inc
```bitbake
SOC_FAMILY =. "rcar-gen3:"
require conf/machine/include/soc-family.inc
LINUXLIBCVERSION = "4.9"
```

## meta-rcar-gen3/conf/machine/include/rcar_common.inc
```bitbake
require conf/machine/include/${SOC_FAMILY}.inc

# 32BIT package install (default is disable)
# This variables can be used only in multilib.
USE_32BIT_PKGS ?= "0"
USE_32BIT_WAYLAND ?= "0"
USE_32BIT_MMP ?= "0"

MACHINE_FEATURES = ""

KERNEL_IMAGETYPE = "Image"
IMAGE_FSTYPES += " tar.bz2 ext4 wic.xz wic.bmap wic.xz.sha256sum"

WKS_FILE ?= "rcar-singlepart-noloader.wks"

SERIAL_CONSOLES = "115200;ttySC0"

# Configuration for kernel
PREFERRED_PROVIDER_virtual/kernel = "linux-renesas"
OLDEST_KERNEL = "5.10"

# Configuration for ARM Trusted Firmware
EXTRA_IMAGEDEPENDS += " arm-trusted-firmware optee-os"
# Add default config to build eMMC boot mode (it should enable USE_EMMC_BOOTMODE = "1" local.conf)
USE_EMMC_BOOTMODE ?= "0"

# u-boot
PREFERRED_VERSION_u-boot = "v2020.10%"
EXTRA_IMAGEDEPENDS += " u-boot"

# Add variable to Build Configuration in build log
BUILDCFG_VARS:append = " SOC_FAMILY"

# sync is required to build kernel-module-gles
# rsync is required to build kernel 5.4
HOSTTOOLS += "sync rsync"

# for gstreamer
PREFERRED_VERSION_gstreamer1.0 = "${@bb.utils.contains('MACHINE_FEATURES', 'multimedia', '1.20.3', '', d)}"
PREFERRED_VERSION_gstreamer1.0-libav = "${@bb.utils.contains('MACHINE_FEATURES', 'multimedia', '1.20.3', '', d)}"
PREFERRED_VERSION_gstreamer1.0-meta-base = "${@bb.utils.contains('MACHINE_FEATURES', 'multimedia', '1.20.3', '', d)}"
PREFERRED_VERSION_gstreamer1.0-omx = "${@bb.utils.contains('MACHINE_FEATURES', 'multimedia', '1.20.3', '', d)}"
PREFERRED_VERSION_gstreamer1.0-plugins-base = "${@bb.utils.contains('MACHINE_FEATURES', 'multimedia', '1.20.3', '', d)}"
PREFERRED_VERSION_gstreamer1.0-plugins-bad = "${@bb.utils.contains('MACHINE_FEATURES', 'multimedia', '1.20.3', '', d)}"
PREFERRED_VERSION_gstreamer1.0-plugins-good = "${@bb.utils.contains('MACHINE_FEATURES', 'multimedia', '1.20.3', '', d)}"
PREFERRED_VERSION_gstreamer1.0-plugins-ugly = "${@bb.utils.contains('MACHINE_FEATURES', 'multimedia', '1.20.3', '', d)}"
```

## meta-rcar-gen3/conf/machine/include/tune-cortexa53.inc
```bitbake
TUNECONFLICTS[aarch64] = "armv4 armv5 armv6 armv7 armv7a"

MACHINEOVERRIDES =. "${@bb.utils.contains("TUNE_FEATURES", "cortexa53", "cortexa53:", "" ,d)}"
```

## meta-rcar-gen3/conf/machine/include/tune-cortexa57-cortexa53.inc
```bitbake
DEFAULTTUNE ?= "cortexa57-cortexa53"

TUNEVALID[cortexa57-cortexa53] = "Enable Cortex-A57.Cortex-A53 specific processor optimizations"
TUNE_CCARGS .= "${@bb.utils.contains('TUNE_FEATURES', 'cortexa57-cortexa53', ' -mcpu=cortex-a57.cortex-a53', '', d)}"

MACHINEOVERRIDES =. "${@bb.utils.contains("TUNE_FEATURES", "cortexa57-cortexa53", "cortexa57-cortexa53:", "" ,d)}"
TUNECONFLICTS[aarch64] = "armv4 armv5 armv6 armv7 armv7a"

require conf/machine/include/arm/arch-armv8a.inc

# Little Endian base configs
AVAILTUNES += "cortexa57-cortexa53 cortexa57-cortexa53-crypto"
ARMPKGARCH_tune-cortexa57-cortexa53             = "cortexa57-cortexa53"
ARMPKGARCH_tune-cortexa57-cortexa53-crypto      = "cortexa57-cortexa53"
TUNE_FEATURES_tune-cortexa57-cortexa53          = "aarch64 cortexa57-cortexa53 crc"
TUNE_FEATURES_tune-cortexa57-cortexa53-crypto   = "aarch64 cortexa57-cortexa53 crc crypto"
PACKAGE_EXTRA_ARCHS_tune-cortexa57-cortexa53             = "${PACKAGE_EXTRA_ARCHS_tune-armv8a-crc} cortexa57-cortexa53"
PACKAGE_EXTRA_ARCHS_tune-cortexa57-cortexa53-crypto      = "${PACKAGE_EXTRA_ARCHS_tune-armv8a-crc-crypto} cortexa57-cortexa53 cortexa57-cortexa53-crypto"
BASE_LIB_tune-cortexa57-cortexa53               = "lib64"
BASE_LIB_tune-cortexa57-cortexa53-crypto        = "lib64"
```

## meta-rcar-gen3/conf/machine/include/tune-cortexa57.inc
```bitbake
DEFAULTTUNE ?= "cortexa57"
require conf/machine/include/arm/arch-armv8.inc

TUNEVALID[cortexa57] = "Enable Cortex-A57 specific processor optimizations"
TUNECONFLICTS[aarch64] = "armv4 armv5 armv6 armv7 armv7a"

TUNE_CCARGS .= "${@bb.utils.contains("TUNE_FEATURES", "aarch64", " -march=armv8-a", "" ,d)}"

MACHINEOVERRIDES =. "${@bb.utils.contains("TUNE_FEATURES", "cortexa57", "cortexa57:", "" ,d)}"

TUNE_CCARGS .= "${@bb.utils.contains("TUNE_FEATURES", "cortexa57", " -mtune=cortex-a57", "", d)}"

# Little Endian base configs
AVAILTUNES += "cortexa57"
ARMPKGARCH_tune-cortexa57 = "cortexa57"
TUNE_FEATURES_tune-cortexa57 = "${TUNE_FEATURES_tune-aarch64} cortexa57"
PACKAGE_EXTRA_ARCHS_tune-cortexa57 = "${PACKAGE_EXTRA_ARCHS_tune-aarch64} cortexa57"
BASE_LIB_tune-cortexa57 = "lib64"
```
