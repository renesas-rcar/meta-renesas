## meta-rcar-adas/conf/layer.conf
```bitbake
# We have a conf and classes directory, add to BBPATH
BBPATH .= ":${LAYERDIR}"

# We have recipes-* directories, add to BBFILES
BBFILES += "${LAYERDIR}/recipes-*/*/*.bb \
	${LAYERDIR}/recipes-*/*/*.bbappend"

BBFILE_COLLECTIONS += "rcar-adas"
BBFILE_PATTERN_rcar-adas = "^${LAYERDIR}/"
BBFILE_PRIORITY_rcar-adas = "6"
LAYERSERIES_COMPAT_rcar-adas = "dunfell"

LAYERDEPENDS_rcar-adas = "rcar-bsp"
```

## meta-rcar-bsp/conf/machine/condor.conf
```bitbake
#@TYPE: Machine
#@NAME: Condor machine
#@DESCRIPTION: Machine configuration for running Condor

SOC_FAMILY = "r8a77980"

# V3x configuration
require conf/machine/include/v3x.inc
```

## meta-rcar-bsp/conf/machine/eagle.conf
```bitbake
#@TYPE: Machine
#@NAME: Eagle machine
#@DESCRIPTION: Machine configuration for running Eagle

SOC_FAMILY = "r8a77970"

# V3x configuration
require conf/machine/include/v3x.inc
```

## meta-rcar-bsp/conf/machine/falcon.conf
```bitbake
#@TYPE: Machine
#@NAME: Falcon machine
#@DESCRIPTION: Machine configuration for running Falcon

SOC_FAMILY = "r8a779a0"

DEFAULTTUNE ?= "cortexa76"
require conf/machine/include/tune-cortexa76.inc
require conf/machine/include/rcar-common.inc

# Device tree for V3U
KERNEL_DEVICETREE = " \
    renesas/r8a779a0-falcon.dtb \
"

# V3U u-boot configure
UBOOT_CONFIG ??= "falcon"
UBOOT_CONFIG[falcon] = "r8a779a0_falcon_defconfig"

# Set Image & SDK name for V3U
IMAGE_NAME = "${IMAGE_BASENAME}-v3u${IMAGE_VERSION_SUFFIX}"
IMAGE_LINK_NAME = "${IMAGE_BASENAME}-v3u"
SDK_NAME_r8a779a0 = "${DISTRO}-${TCLIBC}-${SDKMACHINE}-${IMAGE_BASENAME}-${TUNE_PKGARCH}-v3x"
```

## meta-rcar-bsp/conf/machine/grayhawk.conf
```bitbake
#@TYPE: Machine
#@NAME: Grayhawk machine
#@DESCRIPTION: Machine configuration for running Grayhawk

SOC_FAMILY = "r8a779h0"

DEFAULTTUNE ?= "cortexa76"
require conf/machine/include/arm/armv8-2a/tune-cortexa76.inc
require conf/machine/include/rcar-common.inc

WKS_FILE = "image-v4x.wks"

# Device tree for V4M
KERNEL_DEVICETREE = " \
    renesas/r8a779h0-gray-hawk.dtb \
    renesas/r8a779h0-gray-hawk-uio.dtb \
"

# V4M u-boot configure
UBOOT_CONFIG ??= "grayhawk"
UBOOT_CONFIG[grayhawk] = "r8a779h0_grayhawk_defconfig"

# Set Image & SDK name for V4M
IMAGE_NAME = "${IMAGE_BASENAME}-v4m${IMAGE_VERSION_SUFFIX}"
IMAGE_LINK_NAME = "${IMAGE_BASENAME}-v4m"
SDK_NAME:r8a779h0 = "${DISTRO}-${TCLIBC}-${SDKMACHINE}-${IMAGE_BASENAME}-${TUNE_PKGARCH}-v4m"

PREFERRED_PROVIDER_virtual/egl = "${@bb.utils.contains('MACHINE_FEATURES', 'gsx', 'gles-user-module', '', d)}"
PREFERRED_PROVIDER_virtual/libgles2 = "${@bb.utils.contains('MACHINE_FEATURES', 'gsx', 'gles-user-module', '', d)}"
BBMASK += "${@bb.utils.contains('MACHINE_FEATURES', 'gsx', '', 'meta-renesas/meta-rcar-adas/recipes-graphics/mesa/ \
                                meta-renesas/meta-rcar-adas/recipes-kernel/kernel-module-gles/ \
                                meta-renesas/meta-rcar-adas/recipes-graphics/gles-user-module/', d)}"
```

## meta-rcar-bsp/conf/machine/include/r8a77980.inc
```bitbake
SOC_FAMILY =. "rcar:rcar-v3x:"
require conf/machine/include/soc-family.inc
LINUXLIBCVERSION = "5.4%"
```

## meta-rcar-bsp/conf/machine/include/r8a779g0.inc
```bitbake
SOC_FAMILY =. "rcar:rcar-v4x:"
require conf/machine/include/soc-family.inc
LINUXLIBCVERSION = "5.10%"
```

## meta-rcar-bsp/conf/machine/include/rcar-common.inc
```bitbake
require conf/machine/include/${SOC_FAMILY}.inc

MACHINE_FEATURES = ""

KERNEL_IMAGETYPE = "Image"
IMAGE_FSTYPES += "tar.bz2 wic.gz wic.bmap wic.gz.sha256sum wic.gz.crc"
WKS_FILE ?= "image-v3x.wks"

COMPRESSIONTYPES += "crc"
CONVERSION_CMD_crc = "${RECIPE_SYSROOT_NATIVE}/usr/bin/perl-native/perl \
                      ${RECIPE_SYSROOT_NATIVE}/usr/bin/crc32 \
		      ${IMAGE_NAME}${IMAGE_NAME_SUFFIX}.${type} \
		      > ${IMAGE_NAME}${IMAGE_NAME_SUFFIX}.${type}.crc"

SERIAL_CONSOLES = "115200;ttySC0"

# Configuration for kernel
PREFERRED_PROVIDER_virtual/kernel = "linux-renesas"

# u-boot
EXTRA_IMAGEDEPENDS += " u-boot"

# Add variable to Build Configuration in build log
BUILDCFG_VARS_append = " SOC_FAMILY"

# rsync is required to build kernel 5.4
HOSTTOOLS += "rsync"
```

## meta-rcar-bsp/conf/machine/include/tune-cortexa76.inc
```bitbake
DEFAULTTUNE ?= "cortexa76"

TUNEVALID[cortexa76] = "Enable Cortex-A76 specific processor optimizations"

TUNE_CCARGS .= "${@bb.utils.contains('TUNE_FEATURES', 'cortexa76', ' -mcpu=cortex-a76', '', d)}"

MACHINEOVERRIDES =. "${@bb.utils.contains("TUNE_FEATURES", "cortexa76", "cortexa76:", "" ,d)}"
TUNECONFLICTS[aarch64] = "armv4 armv5 armv6 armv7 armv7a"

require conf/machine/include/arm/arch-armv8-2a.inc

# Little Endian base configs
AVAILTUNES += "cortexa76 cortexa76-crypto"
ARMPKGARCH_tune-cortexa76             = "cortexa76"
ARMPKGARCH_tune-cortexa76-crypto      = "cortexa76"
TUNE_FEATURES_tune-cortexa76          = "aarch64 cortexa76"
TUNE_FEATURES_tune-cortexa76-crypto   = "aarch64 cortexa76 crypto"
PACKAGE_EXTRA_ARCHS_tune-cortexa76             = "${PACKAGE_EXTRA_ARCHS_tune-armv8-2a} cortexa76"
PACKAGE_EXTRA_ARCHS_tune-cortexa76-crypto      = "${PACKAGE_EXTRA_ARCHS_tune-armv8-2a-crypto} cortexa76 cortexa76-crypto"
BASE_LIB_tune-cortexa76               = "lib64"
BASE_LIB_tune-cortexa76-crypto        = "lib64"
```

## meta-rcar-bsp/conf/machine/include/v3x-dtb.inc
```bitbake
# Device tree for V3x
KERNEL_DEVICETREE = " \
    renesas/r8a77970-eagle.dtb \
    renesas/r8a77980-es2-condor.dtb \
    renesas/r8a77980-condor.dtb \
"
```

## meta-rcar-bsp/conf/machine/include/v3x.inc
```bitbake
DEFAULTTUNE ?= "cortexa53"
require conf/machine/include/tune-cortexa53.inc
require conf/machine/include/rcar-common.inc

# Device tree for V3x
KERNEL_DEVICETREE = " \
    renesas/r8a77970-eagle.dtb \
    renesas/r8a77970-es1-v3msk.dtb \
    renesas/r8a77970-v3msk.dtb \
    renesas/r8a77980-es2-condor.dtb \
    renesas/r8a77980-condor.dtb \
    renesas/r8a77980-es2-v3hsk.dtb \
    renesas/r8a77980-v3hsk.dtb \
"

# V3x u-boot configuration
UBOOT_CONFIG ??= "condor eagle v3hsk v3msk"
UBOOT_CONFIG[condor] = "r8a77980_condor_defconfig"
UBOOT_CONFIG[eagle] = "r8a77970_eagle_defconfig"
UBOOT_CONFIG[v3hsk] = "r8a77980_v3hsk_defconfig"
UBOOT_CONFIG[v3msk] = "r8a77970_v3msk_defconfig"

# Set Image & SDK name for V3x
IMAGE_NAME = "${IMAGE_BASENAME}-v3x${IMAGE_VERSION_SUFFIX}"
IMAGE_LINK_NAME = "${IMAGE_BASENAME}-v3x"
SDK_NAME_r8a77980 = "${DISTRO}-${TCLIBC}-${SDKMACHINE}-${IMAGE_BASENAME}-${TUNE_PKGARCH}-v3x"
SDK_NAME_r8a77970 = "${DISTRO}-${TCLIBC}-${SDKMACHINE}-${IMAGE_BASENAME}-${TUNE_PKGARCH}-v3x"
```

## meta-rcar-bsp/conf/machine/white-hawk.conf
```bitbake
#@TYPE: Machine
#@NAME: White-hawk machine
#@DESCRIPTION: Machine configuration for running White-hawk

SOC_FAMILY = "r8a779g0"

DEFAULTTUNE ?= "cortexa76"
require conf/machine/include/tune-cortexa76.inc
require conf/machine/include/rcar-common.inc

WKS_FILE ?= "image-v4x.wks"

# Device tree for V4H
KERNEL_DEVICETREE = " \
    renesas/r8a779a0-falcon.dtb \
"

# V4H u-boot configure
UBOOT_CONFIG ??= "white-hawk"

# Set Image & SDK name for V4H
IMAGE_NAME = "${IMAGE_BASENAME}-v4h${IMAGE_VERSION_SUFFIX}"
IMAGE_LINK_NAME = "${IMAGE_BASENAME}-v4h"
SDK_NAME_r8a779g0 = "${DISTRO}-${TCLIBC}-${SDKMACHINE}-${IMAGE_BASENAME}-${TUNE_PKGARCH}-v4h"
```

## meta-rcar-bsp/conf/machine/whitehawk.conf
```bitbake
#@TYPE: Machine
#@NAME: whitehawk machine
#@DESCRIPTION: Machine configuration for running Whitehawk

SOC_FAMILY = "r8a779g0"

DEFAULTTUNE ?= "cortexa76"
require conf/machine/include/tune-cortexa76.inc
require conf/machine/include/rcar-common.inc

WKS_FILE = "image-v4x.wks"

# Device tree for V4H
KERNEL_DEVICETREE = " \
    renesas/r8a779g0-whitehawk.dtb \
    renesas/r8a779g0-whitehawk-native.dtb \
"

# V4H u-boot configure
UBOOT_CONFIG ??= "whitehawk"
UBOOT_CONFIG[whitehawk] = "r8a779g0_whitehawk_defconfig"

# Set Image & SDK name for V4H
IMAGE_NAME = "${IMAGE_BASENAME}-v4h${IMAGE_VERSION_SUFFIX}"
IMAGE_LINK_NAME = "${IMAGE_BASENAME}-v4h"
SDK_NAME_r8a779g0 = "${DISTRO}-${TCLIBC}-${SDKMACHINE}-${IMAGE_BASENAME}-${TUNE_PKGARCH}-v4h"

DISTRO_FEATURES_remove = "${@bb.utils.contains('MACHINE_FEATURES', 'gsx', 'opengl', '', d)}"

PREFERRED_PROVIDER_virtual/egl = "${@bb.utils.contains('MACHINE_FEATURES', 'gsx', 'gles-user-module', '', d)}"
PREFERRED_PROVIDER_virtual/libgles2 = "${@bb.utils.contains('MACHINE_FEATURES', 'gsx', 'gles-user-module', '', d)}"
BBMASK += "${@bb.utils.contains('MACHINE_FEATURES', 'gsx', '', 'meta-renesas/meta-rcar-adas/recipes-graphics/mesa/ \
                                meta-renesas/meta-rcar-adas/recipes-kernel/kernel-module-gles/ \
                                meta-renesas/meta-rcar-adas/recipes-graphics/gles-user-module/', d)}"
```

## meta-rcar-bsp/wic/image-v3x.wks
```
# short-description: Create image for Renesas V3x Boards (V3M, V3H, V3U)
# long-description: Create a partitioned image for Renesas V3x Boards (V3M, V3H, V3U).
part / --source rootfs --ondisk mmcblk0 --fstype=ext4 --label root --align 4 --extra-space 128M
```

## meta-rcar-bsp/wic/image-v4x.wks
```
# short-description: Create image for Renesas V4x Boards (V4H)
# long-description: Create a partitioned image for Renesas V4x Boards (V4H).
part / --source rootfs --ondisk mmcblk0 --fstype=ext4 --label root --align 4 --extra-space 128M
```

## meta-rcar-gateway/conf/layer.conf
```bitbake
BBPATH .= ":${LAYERDIR}"

# We have recipes-* directories, add to BBFILES
BBFILES += "${LAYERDIR}/recipes-*/*/*.bb \
    ${LAYERDIR}/recipes-*/*/*.bbappend"

BBFILE_COLLECTIONS += "rcar-gateway"
BBFILE_PATTERN_rcar-gateway = "^${LAYERDIR}/"
BBFILE_PRIORITY_rcar-gateway = "6"
LAYERSERIES_COMPAT_rcar-gateway = "dunfell kirkstone"

LAYERDEPENDS_rcar-gateway = "core yocto yoctobsp openembedded-layer meta-python"
```

## meta-rcar-gateway/conf/machine/spider.conf
```bitbake
#@TYPE: Machine
#@NAME: Spider machine
#@DESCRIPTION: Machine configuration for running Spider

SOC_FAMILY = "rcar-gateway:r8a779f0"
DEFAULTTUNE ?= "cortexa55"

require conf/machine/include/tune-cortexa55.inc
require conf/machine/include/soc-family.inc

MACHINE_FEATURES = ""

KERNEL_IMAGETYPE = "Image"
IMAGE_FSTYPES += " tar.bz2"

SERIAL_CONSOLES = "115200;ttySC0"

# Configuration for kernel
PREFERRED_PROVIDER_virtual/kernel = "linux-renesas"
LINUXLIBCVERSION = "5.10%"

# Configuration for ARM Trusted Firmware
EXTRA_IMAGEDEPENDS += " arm-trusted-firmware optee-os"

# u-boot
PREFERRED_VERSION_u-boot = "v2020.10%"
EXTRA_IMAGEDEPENDS += " u-boot"
# S4 u-boot configure
UBOOT_MACHINE = "r8a779f0_spider_defconfig"

# Add variable to Build Configuration in build log
BUILDCFG_VARS:append = " SOC_FAMILY"

# Device tree for S4
KERNEL_DEVICETREE = "renesas/r8a779f0-spider.dtb"
```

## meta-rcar-gen2/conf/layer.conf
```bitbake
# We have a conf and classes directory, add to BBPATH
BBPATH .= ":${LAYERDIR}"

# We have a recipes-* directories, add to BBFILES
BBFILES += "${LAYERDIR}/recipes-*/*/*.bb \
	${LAYERDIR}/recipes-*/*/*.bbappend"

BBFILE_COLLECTIONS += "rcar-gen2"
BBFILE_PATTERN_rcar-gen2 = "^${LAYERDIR}/"
BBFILE_PRIORITY_rcar-gen2 = "6"
```

## meta-rcar-gen2/conf/machine/alt.conf
```bitbake
#@TYPE: Machine
#@NAME: alt
#@DESCRIPTION: Machine configuration for alt systems

require conf/machine/include/r8a7794.inc
require conf/machine/include/rcar-gen2-providers.inc

MACHINE_EXTRA_RRECOMMENDS = " kernel-modules"

IMAGE_FSTYPES += "tar.bz2"

SERIAL_CONSOLE = "38400 ttySC10"

KERNEL_DEVICETREE = "${S}/arch/arm/boot/dts/r8a7794-alt.dts"

KERNEL_EXTRA_ARGS += "LOADADDR=${UBOOT_ENTRYPOINT}"

UBOOT_MACHINE = "alt_config"
UBOOT_ENTRYPOINT = "0x40008000"
UBOOT_LOADADDRESS = "0x40007fc0"

PREFERRED_VERSION_linux-renesas = "3.10%"
PREFERRED_VERSION_linux-libc-headers = "3.10%"
PREFERRED_VERSION_nativesdk-linux-libc-headers = "3.10%"
PREFERRED_VERSION_u-boot = "v2013.01%"
PREFERRED_VERSION_libdrm = "2.4.45%"

MACHINE_FEATURES = "apm usbgadget usbhost vfat alsa ethernet"
```

## meta-rcar-gen2/conf/machine/blanche.conf
```bitbake
#@TYPE: Machine
#@NAME: Blanche machine
#@DESCRIPTION: Machine configuration for running Blanche

SOC_FAMILY = "rcar-gen2:r8a7792"
require conf/machine/include/soc-family.inc
DEFAULTTUNE ?= "cortexa15hf-neon"
require conf/machine/include/tune-cortexa15.inc

LINUXLIBCVERSION = "4.6"

KERNEL_IMAGETYPE = "uImage"
IMAGE_FSTYPES = "tar.bz2 ext4 cpio.gz"

SERIAL_CONSOLE = "38400 ttySC0"

# Configuration for kernel
PREFERRED_PROVIDER_virtual/kernel = "linux-renesas"
PREFERRED_PROVIDER_linux-libc-headers = "linux-libc-headers"
PREFERRED_PROVIDER_nativesdk-linux-libc-headers = "nativesdk-linux-libc-headers"
PREFERRED_PROVIDER_u-boot = "u-boot"
PREFERRED_PROVIDER_virtual/egl = "${@base_contains("DISTRO_FEATURES", "wayland", "libegl", "", d)}"

# Device tree for Blanche
KERNEL_DEVICETREE = "${S}/arch/arm/boot/dts/r8a7792-blanche.dts"

# u-boot
PREFERRED_VERSION_u-boot = "rmobile%"
EXTRA_IMAGEDEPENDS += " u-boot"

KERNEL_EXTRA_ARGS += "LOADADDR=${UBOOT_ENTRYPOINT}"

UBOOT_MACHINE ?= "blanche_config"
UBOOT_ENTRYPOINT = "0x40008000"
UBOOT_LOADADDRESS = "0x40007fc0"

# libdrm
PREFERRED_VERSION_libdrm = "2.4.68"

# Add variable to Build Configuration in build log
BUILDCFG_VARS_append = " SOC_FAMILY"

MACHINE_EXTRA_RRECOMMENDS = " kernel-modules kernel-devicetree"

MACHINE_FEATURES = "apm vfat alsa ethernet"
```

## meta-rcar-gen2/conf/machine/gose.conf
```bitbake
#@TYPE: Machine
#@NAME: gose
#@DESCRIPTION: Machine configuration for gose systems

require conf/machine/include/r8a7793.inc
require conf/machine/include/rcar-gen2-providers.inc

MACHINE_EXTRA_RRECOMMENDS = " kernel-modules"
DEFAULTTUNE = "cortexa15hf-neon"

IMAGE_FSTYPES += "tar.bz2"

SERIAL_CONSOLE = "38400 ttySC6"

KERNEL_DEVICETREE = "${S}/arch/arm/boot/dts/r8a7793-gose.dts"

UBOOT_MACHINE = "gose_config"

# gose depends version 2.4.45 of libdrm
PREFERRED_VERSION_libdrm = "2.4.45%"
```

## meta-rcar-gen2/conf/machine/include/r8a7790.inc
```bitbake
SOC_FAMILY = "r8a7790"
require conf/machine/include/soc-family.inc
require conf/machine/include/tune-cortexa15.inc

PREFERRED_PROVIDER_virtual/kernel ?= "linux-renesas"
PREFERRED_VERSION_linux-renesas ?= "3.10%"
                                                                                                                                                                                              
KERNEL_IMAGETYPE = "uImage"
KERNEL_EXTRA_ARGS += "LOADADDR=${UBOOT_ENTRYPOINT}"

EXTRA_IMAGEDEPENDS += "u-boot"
PREFERRED_PROVIDER_u-boot ?= "u-boot"
PREFERRED_VERSION_u-boot ?= "v2013.01%"
UBOOT_MACHINE = "lager_config"
UBOOT_ENTRYPOINT = "0x40008000"
UBOOT_LOADADDRESS = "0x40007fc0"

MACHINE_FEATURES = "apm usbgadget usbhost vfat alsa ethernet"
```

## meta-rcar-gen2/conf/machine/include/r8a7791.inc
```bitbake
SOC_FAMILY = "rcar-gen2:r8a7791"
require conf/machine/include/soc-family.inc
DEFAULTTUNE ?= "cortexa15hf-neon"
require conf/machine/include/tune-cortexa15.inc

PREFERRED_PROVIDER_virtual/kernel ?= "linux-renesas"
PREFERRED_PROVIDER_linux-libc-headers ?= "linux-libc-headers"
PREFERRED_PROVIDER_nativesdk-linux-libc-headers ?= "nativesdk-linux-libc-headers"
PREFERRED_PROVIDER_u-boot ?= "u-boot"

KERNEL_IMAGETYPE ?= "uImage"
EXTRA_IMAGEDEPENDS += "u-boot"
```

## meta-rcar-gen2/conf/machine/include/r8a7794.inc
```bitbake
SOC_FAMILY = "rcar-gen2:r8a7794"
require conf/machine/include/soc-family.inc
DEFAULTTUNE ?= "cortexa7hf-neon"
require conf/machine/include/tune-cortexa7.inc

PREFERRED_PROVIDER_virtual/kernel ?= "linux-renesas"
PREFERRED_PROVIDER_linux-libc-headers ?= "linux-libc-headers"
PREFERRED_PROVIDER_nativesdk-linux-libc-headers ?= "nativesdk-linux-libc-headers"
PREFERRED_PROVIDER_u-boot ?= "u-boot"

KERNEL_IMAGETYPE ?= "uImage"
EXTRA_IMAGEDEPENDS += "u-boot"
```
